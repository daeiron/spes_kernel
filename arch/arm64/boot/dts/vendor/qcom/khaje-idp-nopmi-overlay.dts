/dts-v1/;
/plugin/;

#include <dt-bindings/interrupt-controller/arm-gic.h>
#include "khaje-idp-nopmi.dtsi"

/ {
	model = "Qualcomm Technologies, Inc. KHAJE IDP nopmi";
	compatible = "qcom,khaje-idp", "qcom,khaje", "qcom,idp";
	qcom,msm-id = <0x206 0x10000>;
	qcom,board-id = <0x10022 0x00>;
	qcom,pmic-id = <0x2d 0x00 0x00 0x00>;
};
